## drivers/input/touchscreen/mediatek/nt36572_common/Kconfig
```kconfig
config TOUCHSCREEN_MTK_NT36572_COMMON
    bool "Novatek NT36572 Touchscreen Driver"
    depends on TOUCHSCREEN_MTK
    help
      This enables support for the Novatek NT36572 touchscreen.
```
